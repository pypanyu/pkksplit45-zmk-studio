## boards/shields/pkksplit45/Kconfig.defconfig
```kconfig
if SHIELD_PKKSPLIT45_LEFT

config ZMK_KEYBOARD_NAME
    default "pkksplit45"

config ZMK_SPLIT_ROLE_CENTRAL
    default y

endif

if SHIELD_PKKSPLIT45_LEFT || SHIELD_PKKSPLIT45_RIGHT

config ZMK_SPLIT
    default y

endif
```

## boards/shields/pkksplit45/Kconfig.shield
```kconfig
config SHIELD_PKKSPLIT45_LEFT
    def_bool $(shields_list_contains,pkksplit45_left)

config SHIELD_PKKSPLIT45_RIGHT
    def_bool $(shields_list_contains,pkksplit45_right)
```
